## board/conti/ge_fdc/Kconfig
```kconfig
if TARGET_D1H
config SYS_SOC
	default "d1h"

config SYS_BOARD
	default "ge_fdc"

config SYS_VENDOR
	default "conti"

config SYS_CONFIG_NAME
	default "ge_fdc"
	
endif
```
